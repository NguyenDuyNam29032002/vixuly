# file: BTL.ioc
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Mcu.Family=STM32F1
Mcu.Name=STM32F103C(8-B)Tx
Mcu.Package=LQFP48
NVIC.PriorityGroup=NVIC_PRIORITYGROUP_4
ProjectManager.HeapSize=0x200
ProjectManager.StackSize=0x400
ProjectManager.TargetToolchain=STM32CubeIDE
RCC.APB1Freq_Value=8000000
RCC.APB2Freq_Value=8000000
board=custom

// file: Core/Src/main.c
/* USER CODE BEGIN Header */
/**
  ******************************************************************************
  * @file           : main.c
  * @brief          : Main program body
  ******************************************************************************
  * @attention
  *
  * Copyright (c) 2026 STMicroelectronics.
  * All rights reserved.
  *
  * This software is licensed under terms that can be found in the LICENSE file
  * in the root directory of this software component.
  * If no LICENSE file comes with this software, it is provided AS-IS.
  *
  ******************************************************************************
  */
/* USER CODE END Header */
#include "main.h"

/* USER CODE BEGIN Includes */
#include "button_ic.h"
#include "led_effects.h"
/* USER CODE END Includes */

/* USER CODE BEGIN PV */
/* Bien theo doi khi debug (them vao Live Expressions trong CubeIDE) */
volatile uint32_t      g_last_press_ms = 0u;           /* Thoi gian lan nhan cuoi (ms) */
volatile ButtonEvent_t g_last_event    = BTN_EVT_NONE; /* Loai lan nhan cuoi           */
volatile uint32_t      g_press_count   = 0u;           /* Tong so lan nhan hop le      */
/* USER CODE END PV */

void SystemClock_Config(void);
/* USER CODE BEGIN PFP */
static void App_HandleButton(void);
static void StatusLed_Task(uint32_t now_ms);
/* USER CODE END PFP */

int main(void)
{

  /* MCU Configuration--------------------------------------------------------*/

  /* Reset of all peripherals, Initializes the Flash interface and the Systick. */
  HAL_Init();

  /* Configure the system clock */
  SystemClock_Config();

  /* Initialize all configured peripherals */
  /* USER CODE BEGIN 2 */
  LedFx_Init();      /* PB8..PB15 + PC13, he thong mac dinh BAT  */
  Button_Init();     /* PA0 + TIM2 CH1 Input Capture             */
  /* USER CODE END 2 */

  /* Infinite loop */
  while (1)
  {

    /* USER CODE BEGIN 3 */
    uint32_t now = HAL_GetTick();

    App_HandleButton();      /* Xu ly su kien do Input Capture do duoc */
    LedFx_Task(now);         /* Chay hieu ung LED (khong chan)         */
    StatusLed_Task(now);     /* Bao hieu tren LED PC13                 */
  }
  /* USER CODE END 3 */
}

void SystemClock_Config(void)
{
  RCC_OscInitTypeDef RCC_OscInitStruct = {0};
  RCC_ClkInitTypeDef RCC_ClkInitStruct = {0};

  /** Initializes the RCC Oscillators according to the specified parameters
  * in the RCC_OscInitTypeDef structure.
  */
  RCC_OscInitStruct.OscillatorType = RCC_OSCILLATORTYPE_HSI;
  RCC_OscInitStruct.HSIState = RCC_HSI_ON;
  RCC_OscInitStruct.HSICalibrationValue = RCC_HSICALIBRATION_DEFAULT;
  RCC_OscInitStruct.PLL.PLLState = RCC_PLL_NONE;
  if (HAL_RCC_OscConfig(&RCC_OscInitStruct) != HAL_OK)
  {
    Error_Handler();
  }

  /** Initializes the CPU, AHB and APB buses clocks
  */
  RCC_ClkInitStruct.ClockType = RCC_CLOCKTYPE_HCLK|RCC_CLOCKTYPE_SYSCLK
                              |RCC_CLOCKTYPE_PCLK1|RCC_CLOCKTYPE_PCLK2;
  RCC_ClkInitStruct.SYSCLKSource = RCC_SYSCLKSOURCE_HSI;
  RCC_ClkInitStruct.AHBCLKDivider = RCC_SYSCLK_DIV1;
  RCC_ClkInitStruct.APB1CLKDivider = RCC_HCLK_DIV1;
  RCC_ClkInitStruct.APB2CLKDivider = RCC_HCLK_DIV1;

  if (HAL_RCC_ClockConfig(&RCC_ClkInitStruct, FLASH_LATENCY_0) != HAL_OK)
  {
    Error_Handler();
  }
}

/* USER CODE BEGIN 4 */

/**
  * @brief  Lay su kien nut nhan va dieu khien hieu ung:
  *         - Nhan nhap   (< 1 s)  : doi kieu hieu ung LED
  *         - Nhan giu vua (1..3 s): tang/giam toc do
  *         - Nhan giu lau (> 3 s) : bat/tat toan bo he thong (Standby)
  */
static void App_HandleButton(void)
{
  uint32_t      ms;
  ButtonEvent_t evt;

  while ((evt = Button_GetEvent(&ms)) != BTN_EVT_NONE)
  {
    g_last_press_ms = ms;
    g_last_event    = evt;
    g_press_count++;

    switch (evt)
    {
      case BTN_EVT_SHORT:
        if (LedFx_IsEnabled())
        {
          LedFx_NextEffect();
        }
        break;

      case BTN_EVT_MEDIUM:
        if (LedFx_IsEnabled())
        {
          LedFx_ChangeSpeed();
        }
        break;

      case BTN_EVT_LONG:
        LedFx_SetEnabled(!LedFx_IsEnabled());
        break;

      default:
        break;
    }
  }
}

/**
  * @brief  LED PC13 bao hieu cho nguoi dung:
  *         - Dang giu nut >= 1 s : sang lien  -> nha ra se la "giu vua"
  *         - Dang giu nut >  3 s : nhay nhanh -> nha ra se la "giu lau"
  *         - He thong Standby    : chop ngan moi 2 s (nhip tim)
  *         - Binh thuong         : tat
  */
static void StatusLed_Task(uint32_t now_ms)
{
  uint32_t hold = Button_GetHoldTimeMs();
  bool on;

  if (hold > BTN_MEDIUM_MAX_MS)
  {
    on = (((now_ms / 100u) & 1u) != 0u);
  }
  else if (hold >= BTN_SHORT_MAX_MS)
  {
    on = true;
  }
  else if (!LedFx_IsEnabled())
  {
    on = ((now_ms % 2000u) < 100u);
  }
  else
  {
    on = false;
  }

  StatusLed_Set(on);
}

/* USER CODE END 4 */

void Error_Handler(void)
{
  __disable_irq();
  while (1)
  {
  }
}
